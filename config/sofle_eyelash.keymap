/*                KEY POSITIONS

  ╭────────────────────────╮     ╭────╮     ╭────────────────────────╮
  │ 0   1   2   3   4   5  │     │ UP │     │ 6   7   8   9   10  11 │
  │ 12  13  14  15  16  17 │     │ DN │     │ 18  19  20  21  22  23 │
  │ 24  25  26  27  28  29 │     │ LF │     │ 30  31  32  33  34  35 │
  │ 36  37  38  39  40  41 ╰───╮ │ RT │ ╭───╯ 43  44  45  46  47  48 │
  ╰───╮ 50  51  52  53  54  55 │ │ PR │ │ 55  56  57  58  59  60 ╭───╯
      ╰────────────────────────╯ ╰────╯ ╰────────────────────────╯ */

#define LAYER(LAYER, NAME, \
K00, K01, K02, K03, K04, K05,           K06, K07, K08, K09, K10, K11, \
K12, K13, K14, K15, K16, K17,           K18, K19, K20, K21, K22, K23, \
K24, K25, K26, K27, K28, K29,           K30, K31, K32, K33, K34, K35, \
K36, K37, K38, K39, K40, K41,           K44, K45, K46, K47, K48, K49, \
          K50, K51, K52, K53, K54, K55, K56, K57, K58, K59, \
          EN1_INC, EN1_DEC, EN1_BTN, \
          EN2_INC, EN2_DEC, EN2_BTN, \
          F_UP, F_DN, F_LF, F_RT, F_PR \
) \
LAYER { \
    display-name = NAME; \
    bindings = < \
        K00 K01 K02 K03 K04 K05          F_UP          K06 K07 K08 K09 K10 K11 \
        K12 K13 K14 K15 K16 K17          F_DN          K18 K19 K20 K21 K22 K23 \
        K24 K25 K26 K27 K28 K29          F_LF          K30 K31 K32 K33 K34 K35 \
        K36 K37 K38 K39 K40 K41          F_RT          K44 K45 K46 K47 K48 K49 \
        EN1_BTN K50 K51 K52 K53 K54      F_PR      K55 K56 K57 K58 K59 \
    >; \
    sensor-bindings = <&inc_dec_kp EN1_INC EN1_DEC>; \
};

#include "include/base.dtsi"