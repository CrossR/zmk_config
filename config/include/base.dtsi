#include "general.dtsi"

/ {

    #include "combos.dtsi"
    #include "behaviors.dtsi"

    keymap {
        compatible = "zmk,keymap";

LAYER(BASE_LAYER, "Base",
    &kp ESC,    &kp NUM_1,   &kp NUM_2,   &kp NUM_3,   &kp NUM_4,   &kp NUM_5,                         &kp NUM_6,   &kp NUM_7,   &kp NUM_8,   &kp NUM_9,   &kp NUM_0,   L_GAME,
    &kp TAB,    &kp Q,       &kp W,       &kp E,       &kp R,       &kp T,                             &kp Y,       &kp U,       &kp I,       &kp O,       &kp P,       &kp 0x64,
    &kp LCTL,   A_L1,        &kp S,       &kp D,       &kp F,       &kp G,                             &kp H,       &kp J,       &kp K,       &kp L,       SCLN_L2,     &kp QUOT,
    SPCCDT_L,   &kp Z,       &kp X,       &kp C,       &kp V,       &kp B,                             &kp N,       &kp M,       &kp CMMA,    &kp DOT,     &kp FSLH,    SPCCDT_R,
                             &kp LALT,    &kp LGUI,    &kp LBKT,    DEL_L1,    &kp SPC,     &kp BKSP,  RET_L2,      &kp RBKT,    &kp RALT,    &kp RGUI,
    // Encoder bindings, increment, decrement, and press
    &scroll_encoder, XXXXX,
    &volume_encoder, &kp M_MUTE,

    // Four way encoder bindings, up, down, left, right, press
    &mmv MOVE_UP, &mmv MOVE_DOWN, &mmv MOVE_LEFT, &mmv MOVE_RIGHT,  &mkp LCLK
)

LAYER(RAISE_LAYER, "Raise",
    UNLCK,      &kp F1,      &kp F2,      &kp F3,      &kp F4,      &kp F5,                           &kp F6,      &kp F7,      &kp F8,      &kp F9,      &kp F10,     &kp F11,
    ______,     &kp NUM_1,   &kp NUM_2,   &kp NUM_3,   &kp NUM_4,   &kp NUM_5,                        &kp NUM_6,   &kp NUM_7,   &kp NUM_8,   &kp NUM_9,   &kp NUM_0,   &kp F12,
    ______,     ______,      ______,      &kp PRCNT,   &kp EQL,     &kp PLUS,                         &kp MINUS,   &kp UNDER,   &kp CARET,   ______,      ______,      ______,
    ______,     ______,      ______,      ______,      ______,      ______,                           &kp DLLR,    &kp ASTRK,   &kp AMPS,    ______,      ______,      ______,
                             ______,      ______,      ______,      ______,     ______,    ______,    ______,      ______,      ______,      ______,
    // Encoder bindings, increment, decrement, and press
    &scroll_encoder, XXXXX,
    &volume_encoder, &kp M_MUTE,

    // Four way encoder bindings, up, down, left, right, press
    &kp UP_ARROW, &kp DOWN_ARROW, &kp LEFT_ARROW, &kp RIGHT_ARROW, &kp ENTER
)

LAYER(LOWER_LAYER, "Lower",
    BTCLR,      PC_BT,       MAC_BT,      PHONE_BT,    TAB_BT,      BT5,                              ______,      ______,      ______,      ______,      L_MAC,       TOG_OUT,
    ______,     ______,      &kp UARW,    ______,      ______,      ______,                           ______,      ______,      ______,      ______,      ______,      TOG_USB,
    ______,     &kp LARW,    &kp DARW,    &kp RARW,    &kp LBKT,    ______,                           &kp 0x32,    &kp RBKT,    ______,      ______,      ______,      ______,
    ______,     PREVI,       PLAY,        NEXT,        ______,      ______,                           ______,      &kp TILDE2,  ______,      ______,      ______,      TOG_BLE,
                             ______,      ______,      ______,      &kp GRAV,   ______,    ______,    ______,      ______,      ______,      ______,
    // Encoder bindings, increment, decrement, and press
    &scroll_encoder, XXXXX,
    &volume_encoder, &kp M_MUTE,

    // Four way encoder bindings, up, down, left, right, press
    &kp UP_ARROW, &kp DOWN_ARROW, &kp LEFT_ARROW, &kp RIGHT_ARROW, &kp ENTER
)

LAYER(GAMING_LAYER, "Gaming",
    &kp ESC,    &kp NUM_1,   &kp NUM_2,   &kp NUM_3,   &kp NUM_4,   &kp NUM_5,                           &kp NUM_6,   &kp NUM_7,   &kp NUM_8,   &kp NUM_9,   &kp NUM_0,   L_GAME,
    &kp TAB,    &kp Q,       &kp W,       &kp E,       &kp R,       &kp T,                               &kp Y,       &kp U,       &kp I,       &kp O,       &kp P,       &kp 0x64,
    &kp LCTL,   &kp A,       &kp S,       &kp D,       &kp F,       &kp G,                               &kp H,       &kp J,       &kp K,       &kp L,       &kp SCLN,    &kp QUOT,
    &kp LSFT,   &kp Z,       &kp X,       &kp C,       &kp V,       &kp B,                               &kp N,       &kp M,       &kp CMMA,    &kp DOT,     &kp FSLH,    SPCCDT_R,
                             &kp LALT,    &kp RET,     &kp M,       &kp LALT,   &kp SPC,    &kp BKSP,    RET_L4,      &kp RBKT,    &kp RALT,    &kp RGUI,
    // Encoder bindings
    &game_encoder, &kp GAME_1,
    &volume_encoder, &kp M_MUTE,

    // Four way encoder bindings, up, down, left, right, press
    &kp UP_ARROW, &kp DOWN_ARROW, &kp LEFT_ARROW, &kp RIGHT_ARROW, &kp ENTER
)

LAYER(GAMING_ALT_LAYER, "Gaming Alt",
    ______,     &kp F1,      &kp F2,      &kp F3,      &kp F4,      &kp F5,                           &kp F6,      &kp F7,      &kp F8,      &kp F9,      &kp F10,     &kp F11,
    ______,     ______,      ______,      ______,      ______,      ______,                           ______,      KP_1,        KP_2,        KP_3,        ______,      &kp F12,
    ______,     ______,      ______,      ______,      ______,      ______,                           ______,      KP_4,        KP_5,        KP_6,        ______,      ______,
    ______,     ______,      ______,      ______,      ______,      ______,                           ______,      KP_7,        KP_8,        KP_9,        ______,      ______,
                             ______,      ______,      ______,      &kp DEL,    ______,    ______,    ______,      ______,      ______,      KP_0,
    // Encoder bindings
    &game_encoder, &kp GAME_1,
    &volume_encoder, &kp M_MUTE,

    // Four way encoder bindings, up, down, left, right, press
    &kp UP_ARROW, &kp DOWN_ARROW, &kp LEFT_ARROW, &kp RIGHT_ARROW, &kp ENTER
)

LAYER(MAC_LAYER, "Mac",
    &kp ESC,    &kp NUM_1,   &kp NUM_2,   &kp NUM_3,   &kp NUM_4,   &kp NUM_5,                          &kp NUM_6,   &kp NUM_7,   &kp NUM_8,   &kp NUM_9,   &kp NUM_0,   L_MAC,
    &kp TAB,    &kp Q,       &kp W,       &kp E,       &kp R,       &kp T,                              &kp Y,       &kp U,       &kp I,       &kp O,       &kp P,       &kp 0x64,
    &kp LCTL,   A_L6,        &kp S,       &kp D,       &kp F,       &kp G,                              &kp H,       &kp J,       &kp K,       &kp L,       SCLN_L7,     &kp QUOT,
    SPCCDT_L,   &kp Z,       &kp X,       &kp C,       &kp V,       &kp B,                              &kp N,       &kp M,       &kp CMMA,    &kp DOT,     &kp FSLH,    SPCCDT_R,
                             &kp LALT,    &kp LGUI,    &kp LBKT,    DEL_L6,     &kp SPC,    &kp BKSP,   RET_L7,      &kp RBKT,    &kp RALT,    &kp RGUI,
    // Encoder bindings, increment, decrement, and press
    &scroll_encoder, XXXXX,
    &volume_encoder, &kp M_MUTE,

    // Four way encoder bindings, up, down, left, right, press
    &kp UP_ARROW, &kp DOWN_ARROW, &kp LEFT_ARROW, &kp RIGHT_ARROW, &kp ENTER
)

LAYER(MAC_RAISE_LAYER, "Mac Raise",
    ______,     &kp F1,      &kp F2,      &kp F3,      &kp F4,      &kp F5,                           &kp F6,      &kp F7,      &kp F8,      &kp F9,      &kp F10,     &kp F11,
    ______,     &kp NUM_1,   &kp NUM_2,   &kp NUM_3,   &kp NUM_4,   &kp NUM_5,                        &kp NUM_6,   &kp NUM_7,   &kp NUM_8,   &kp NUM_9,   &kp NUM_0,   &kp F12,
    ______,     ______,      ______,      &kp PRCNT,   &kp EQL,     &kp PLUS,                         &kp MINUS,   &kp UNDER,   &kp CARET,   ______,      ______,      ______,
    ______,     ______,      ______,      ______,      ______,      ______,                           &kp DLLR,    &kp ASTRK,   &kp AMPS,    ______,      ______,      ______,
                             ______,      ______,      ______,      ______,     ______,    ______,    ______,      ______,      ______,      ______,
    // Encoder bindings, increment, decrement, and press
    &scroll_encoder, XXXXX,
    &volume_encoder, &kp M_MUTE,

    // Four way encoder bindings, up, down, left, right, press
    &kp UP_ARROW, &kp DOWN_ARROW, &kp LEFT_ARROW, &kp RIGHT_ARROW, &kp ENTER
)

LAYER(MAC_LOWER_LAYER, "Mac Lower",
    BTCLR,      PC_BT,       MAC_BT,      PHONE_BT,    TAB_BT,      BT5,                              ______,      ______,      ______,      ______,      L_MAC,       TOG_OUT,
    ______,     ______,      &kp UARW,    ______,      ______,      ______,                           ______,      ______,      ______,      ______,      ______,      TOG_USB,
    ______,     &kp LARW,    &kp DARW,    &kp RARW,    &kp LBKT,    ______,                           &kp 0x32,    &kp RBKT,    ______,      ______,      ______,      ______,
    ______,     PREVI,       PLAY,        NEXT,        ______,      ______,                           ______,      &kp TILDE,   ______,      ______,      ______,      TOG_BLE,
                             ______,      ______,      ______,      &kp GRAV,   ______,    ______,    ______,      ______,      ______,      ______,

    // Encoder bindings, increment, decrement, and press
    &scroll_encoder, XXXXX,
    &volume_encoder, &kp M_MUTE,

    // Four way encoder bindings, up, down, left, right, press
    &kp UP_ARROW, &kp DOWN_ARROW, &kp LEFT_ARROW, &kp RIGHT_ARROW, &kp ENTER
)
    };
};
