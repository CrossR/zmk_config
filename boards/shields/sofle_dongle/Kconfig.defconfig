## boards/shields/sofle_dongle/Kconfig.defconfig
```kconfig
if SHIELD_SOFLE_DONGLE

# Max 16 characters in keyboard name
config ZMK_KEYBOARD_NAME
    default "Sofle Dongle"

config ZMK_SPLIT_ROLE_CENTRAL
    default y

config ZMK_SPLIT
    default y

endif
```

## config/west.yml
```yaml
manifest:
  remotes:
    - name: zmkfirmware
      url-base: https://github.com/zmkfirmware
    - name: a741
      url-base: https://github.com/a741725193
    - name: m165437
      url-base: https://github.com/M165437
  projects:
    - name: zmk
      remote: zmkfirmware
      revision: main
      import: app/west.yml
    - name: zmk-sofle
      remote: a741
      revision: main
    - name: nice-view-gem
      remote: m165437
      revision: main
  self:
    path: config
```
